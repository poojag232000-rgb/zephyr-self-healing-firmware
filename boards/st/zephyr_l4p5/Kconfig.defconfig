## boards/st/zephyr_l4p5/Kconfig.defconfig
```kconfig
# SPDX-License-Identifier: Apache-2.0

if BOARD_ZEPHYR_L4P5

config ARM_MPU
	default y

endif # BOARD_ZEPHYR_L4P5
```

## boards/st/zephyr_l4p5/Kconfig.zephyr_l4p5
```kconfig
# SPDX-License-Identifier: Apache-2.0

config BOARD_ZEPHYR_L4P5
	select SOC_STM32L4P5XX
```

## boards/st/zephyr_l4p5/board.yml
```yaml
board:
  name: zephyr_l4p5
  full_name: ZEPHYR on NUCLEO-L4P5ZG
  vendor: st
  socs:
    - name: stm32l4p5xx
```
